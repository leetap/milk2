/*
 * Copyright (c) 2022 The ZMK Contributors
 *
 * SPDX-License-Identifier: MIT
 */

#include <behaviors.dtsi>
#include <dt-bindings/zmk/bt.h>
#include <dt-bindings/zmk/keys.h>

/ {
    keymap {
        compatible = "zmk,keymap";

        default_layer {
            bindings = <
&kp N0  &lt 1 NUMBER_2
            >;
        };

        Bluetooth {
            bindings = <
&bt BT_CLR_ALL  &trans
            >;
        };
    };
};
